## esp32s3/sdkconfig.defaults
```kconfig
CONFIG_COMPILER_CXX_EXCEPTIONS=y
CONFIG_IDF_TARGET="esp32s3"
CONFIG_LIBC_NEWLIB=y
CONFIG_FREERTOS_THREAD_LOCAL_STORAGE_POINTERS=2

CONFIG_ESP_TIMER_SUPPORTS_ISR_DISPATCH_METHOD=y
```
